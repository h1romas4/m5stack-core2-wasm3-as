## main/Kconfig.projbuild
```kconfig
menu "WebAssembly Apps"
    choice
        prompt "Select WebAssembly Apps"
            default WASM_CLOCK
        config WASM_CLOCK
            bool "Clock"
        config WASM_3DCUBE
            bool "3D Cube Demo"
        config WASM_3DCUBE_IMU6886
            bool "3D Cube Demo with IMU6886"
        config WASM_UNITGPS
            bool "UNIT GPS"
    endchoice
endmenu
```
